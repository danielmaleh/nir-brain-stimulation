/**
 * @file main.ino
 * @brief Main Experiment Controller for the NIR tPBM Device.
 *
 * Controls the experimental sequences for the Transcranial Photobiomodulation (tPBM)
 * study, including the 10 Hz NIR stimulation, 40 Hz NIR stimulation, and the
 * Heating control condition.
 *
 * Control interface:
 * - There are NO physical buttons. The device is driven entirely over USB serial
 *   (single-letter commands below), typically via the APP/arduino.html dashboard.
 *     M = cycle mode   G = go/start   X = stop   S = simulate over-temp   R = reset trip
 *
 * Hardware driver:
 * - Loads are switched by a TB6612FNG dual driver. Channel A (PWMA = D9) drives
 *   the NIR LED strip; channel B (PWMB = D10) drives the heater. The driver's STBY
 *   pin is tied to 5V (always enabled) by default. Optionally it can be Arduino-
 *   controlled for a redundant hardware kill; see TB_STBY_CONTROL in pins.h.
 *
 * Pulse timing:
 * - The NIR pulse train is generated by a Timer1 CTC compare interrupt, NOT by the
 *   main loop, so the 10/40 Hz edges are immune to jitter from the blocking DS18B20
 *   reads and Serial traffic. Prescaler 64 (4 us/tick) yields exact half-periods:
 *   12500 ticks = 50.000 ms (10 Hz) and 3125 ticks = 12.500 ms (40 Hz).
 * - Each edge is timestamped in the ISR and drained to Serial by loop().
 *
 * Safety Limits & Blinding:
 * - Skin temperature must never exceed 40.0 C.
 * - Non-blocking timing is used to ensure safety checks run continuously.
 * - Mode indicator LEDs are turned OFF immediately when stimulation begins to maintain blinding.
 * - Logging of all events, temperatures, and pulses is written to the serial interface.
 *
 * Target Hardware:
 * - Arduino Uno/Mega
 * - DS18B20 Temperature Sensor (using DallasTemperature & OneWire libraries)
 * - TB6612FNG dual driver for NIR LED and Heater control
 */

#include <OneWire.h>
#include <DallasTemperature.h>
#include "pins.h"

// --- Configuration & Constants ---
const float MAX_SAFE_TEMP = 40.0;        // Emergency cutoff temperature (Celsius)
const float HEATER_TARGET_DEFAULT = 37.5; // Default heating-control set point (Celsius)
const float HEATER_HYSTERESIS = 0.5;      // Hysteresis window for heating control (Celsius)

// Heating-control set point. Mutable so the host can match it to the temperature
// that the 10/40 Hz NIR reached during calibration (see calibrate_thermal.py).
// Clamped strictly below the safety cutoff whenever set via the 'H' command.
float heaterTargetTemp = HEATER_TARGET_DEFAULT;
const float HEATER_TARGET_MIN = 25.0;
const float HEATER_TARGET_MAX = MAX_SAFE_TEMP - 1.0; // never within 1 C of the 40 C cutoff

// --- Heater controller -----------------------------------------------------
// Set to 1 for closed-loop PID control of the heating-control temperature; set
// to 0 to fall back to the simple on-off hysteresis thermostat (runHeaterThermostat).
#define HEATER_USE_PID 1
//
// The heater is a slow thermal load and shares Timer1 with the NIR pulse
// generator (which never runs in the heating condition), so instead of hardware
// PWM the PID output is applied as a TIME-PROPORTIONED (slow-PWM) duty over a
// 1 s window: the pin is ON for (duty * window) each window. This needs no PWM
// pin and cannot collide with the NIR timer.
//
// GAINS ARE A STARTING POINT AND MUST BE TUNED ON THE REAL DEVICE. The DS18B20
// runs at 10-bit resolution (0.25 C steps), so the derivative term is noisy;
// Kd defaults to 0 (i.e. PI control) and is smoothed by an EMA when enabled.
const float HEATER_KP = 0.60;              // duty per +1 C of error
const float HEATER_KI = 0.08;              // duty per (C*s) of accumulated error
const float HEATER_KD = 0.00;              // duty per (C/s); 0 = PI control (see note)
const float HEATER_D_FILTER = 0.80;        // EMA smoothing for the derivative term [0..1)
const float HEATER_INTEGRAL_MAX = 1.0;     // anti-windup: clamp on the Ki*integral contribution
const unsigned long HEATER_PID_INTERVAL_MS = 200;  // recompute rate (matches the temperature poll)
const unsigned long HEATER_PWM_WINDOW_MS = 1000;   // time-proportioned output window
const float HEATER_MAX_DUTY = 0.20;        // hard cap on heater duty (safety-limit an over-powered heater)

// Rate-of-rise cutoff: if the skin temperature climbs faster than this, latch a
// safety trip immediately instead of waiting to reach 40 C. Catches a runaway in
// ~1 s. NOTE: this only helps when D10 actually switches the heater OFF; it CANNOT
// protect against a shorted MOSFET (an independent in-line thermal fuse must).
const float HEATER_MAX_RISE_C_PER_S = 5.0;

// PID state (reset each time the heating-control condition starts).
float heaterIntegral = 0.0;
float heaterPrevError = 0.0;
float heaterDerivFiltered = 0.0;
float heaterDuty = 0.0;
unsigned long heaterLastPidMs = 0;
unsigned long heaterWindowStartMs = 0;
unsigned long heaterLastPidLogMs = 0;

const unsigned long STIMULATION_DURATION_MS = 60000; // 1 minute of stimulation
const unsigned long REST_DURATION_MS = 180000;       // 3 minutes of rest between conditions

const unsigned long TEMP_POLL_INTERVAL_MS = 200;    // Poll temperature every 200ms
const unsigned long LOG_POLL_INTERVAL_MS = 1000;    // Log rest-phase countdown every 1 second

// Timer1 compare values (CTC mode, prescaler 64 -> 4 us/tick) for a 50% duty pulse.
// These give exact half-periods, so the average frequency is crystal-accurate.
const unsigned int TIMER1_OCR_10HZ = 12499; // (12499+1)*4us = 50.000 ms half-period -> 10 Hz
const unsigned int TIMER1_OCR_40HZ = 3124;  // (3124+1)*4us  = 12.500 ms half-period -> 40 Hz

// --- System State Machine ---
enum SystemState {
  STATE_IDLE,          // Waiting for user to select mode and start stimulation
  STATE_STIMULATING,   // Active condition running (1 minute)
  STATE_REST,          // Cooldown/rest period (3 minutes)
  STATE_SAFETY_TRIP    // Locked out due to temperature exceeding safety limits
};

enum StimCondition {
  COND_HEATING = 0,    // Heating control (skin warming only)
  COND_10HZ = 1,       // 10 Hz NIR stimulation
  COND_40HZ = 2,       // 40 Hz NIR stimulation
  COND_COUNT = 3
};

SystemState currentState = STATE_IDLE;
StimCondition selectedCondition = COND_HEATING;

// --- Timing Variables ---
unsigned long stateStartTimeMs = 0;
unsigned long lastTempPollTimeMs = 0;
unsigned long lastLogTimeMs = 0;

// --- NIR pulse generator (Timer1 interrupt) ---
volatile bool nirPulseState = false;

// Lock-free ring buffer of pulse edges captured in the ISR and drained by loop().
// Keeps accurate per-edge timestamps without doing Serial I/O inside the interrupt.
const uint8_t PULSE_BUF_SIZE = 16;
volatile unsigned long pulseEvtTimeUs[PULSE_BUF_SIZE];
volatile uint8_t pulseEvtState[PULSE_BUF_SIZE];
volatile uint8_t pulseBufHead = 0;        // advanced by ISR (producer)
volatile unsigned int pulseDropped = 0;   // edges lost to a full buffer
uint8_t pulseBufTail = 0;                 // advanced by loop() (consumer)

// Temperature Sensor variables
OneWire oneWire(PIN_TEMP_SENSOR);
DallasTemperature sensors(&oneWire);
DeviceAddress tempDeviceAddress;
float currentTemp = 0.0;
bool sensorConnected = false;

// The DS18B20 scratchpad powers up holding +85.00 C. Reading before a conversion
// has completed returns that value - it is a reset artifact, never a real skin
// temperature, and must not be fed into the safety comparator (85 >= 40 would
// falsely latch a trip right after boot / Web Serial connect).
const float DS18B20_POWERON_C = 85.0;
const uint8_t MAX_SUSPECT_READS = 3; // consecutive 85 C reads before declaring a sensor fault
uint8_t suspectReadCount = 0;

// --- Function Declarations ---
void changeState(SystemState newState);
void checkSafety();
void updateActuators();
void handleSerialCommands();
void cycleMode();
void startStimulation();
void stopStimulation(const char* reason);
void triggerSafetyShutdown(const char* reason);
void runHeaterThermostat();
void runHeaterPID();
void resetHeaterPID();
void updateStatusLEDs();
void flashErrorLED();
void startNirPulse(unsigned int ocrValue);
void stopNirPulse();
void drainPulseLog();

void setup() {
  // Initialize Pins
  pinMode(PIN_NIR_LED, OUTPUT);
  pinMode(PIN_HEATER, OUTPUT);
#if TB_STBY_CONTROL
  pinMode(PIN_TB_STBY, OUTPUT);
#endif
  pinMode(PIN_LED_HEATING, OUTPUT);
  pinMode(PIN_LED_10HZ, OUTPUT);
  pinMode(PIN_LED_40HZ, OUTPUT);
  pinMode(PIN_LED_ERROR, OUTPUT);

  // Default outputs to off. Enable the TB6612 driver only if we control STBY;
  // otherwise STBY is tied to 5V on the board and is always enabled.
  digitalWrite(PIN_NIR_LED, LOW);
  digitalWrite(PIN_HEATER, LOW);
#if TB_STBY_CONTROL
  digitalWrite(PIN_TB_STBY, HIGH);
#endif
  digitalWrite(PIN_LED_HEATING, LOW);
  digitalWrite(PIN_LED_10HZ, LOW);
  digitalWrite(PIN_LED_40HZ, LOW);
  digitalWrite(PIN_LED_ERROR, LOW);

  // Initialize Serial logging
  Serial.begin(115200);
  while (!Serial) {
    ; // Wait for serial connection
  }

  Serial.println(F("=================================================="));
  Serial.println(F("NIR Brain Stimulation - Main Experiment Controller"));
  Serial.println(F("=================================================="));
  Serial.println(F("Serial control: M=mode  G=go  X=stop  S=sim-overtemp  R=reset  H<temp>=heater target"));
  Serial.setTimeout(150); // bound parseFloat() when reading the 'H' argument

  // Initialize Temperature Sensor
  sensors.begin();
  int deviceCount = sensors.getDeviceCount();
  if (deviceCount == 0) {
    Serial.println(F("CRITICAL ERROR: No temperature sensor detected!"));
    triggerSafetyShutdown("Sensor missing at setup.");
  } else {
    if (!sensors.getAddress(tempDeviceAddress, 0)) {
      Serial.println(F("CRITICAL ERROR: Could not get sensor address."));
      triggerSafetyShutdown("Sensor address acquisition failed.");
    } else {
      sensors.setResolution(tempDeviceAddress, 10); // 10-bit resolution (0.25 C steps, ~187.5ms conversion)
      sensors.setWaitForConversion(false);          // Non-blocking reads
      sensors.requestTemperatures();                // Request first measurement
      sensorConnected = true;
      Serial.println(F("Temperature sensor initialized."));
      Serial.println(F("System state: IDLE. Send 'M' to select mode, 'G' to start."));
      updateStatusLEDs();
    }
  }

  // Header format for data output
  // TIMESTAMP_US,EVENT_TYPE,VALUE1,VALUE2
  Serial.println(F("LOG_FORMAT: TIMESTAMP_US,EVENT_TYPE,VALUE1,VALUE2"));
  Serial.println(F("--------------------------------------------------"));
}

void loop() {
  unsigned long currentTimeMs = millis();

  // 0. Drain any NIR pulse edges captured by the Timer1 ISR to the serial log.
  drainPulseLog();

  // 1. Periodically poll temperature (non-blocking conversion, but the bus read
  //    itself is blocking - pulse timing is unaffected because it is timer-driven).
  //    Runs in EVERY state, including SAFETY_TRIP, so the operator can watch the
  //    temperature come back down after a trip; the trip itself stays latched.
  if (sensorConnected && currentTimeMs - lastTempPollTimeMs >= TEMP_POLL_INTERVAL_MS) {
    // Only read once the conversion has actually finished. Reading earlier returns
    // the previous scratchpad contents - on the first poll after reset that is the
    // +85 C power-on value, which would falsely trip the 40 C cutoff.
    if (sensors.isConversionComplete()) {
      lastTempPollTimeMs = currentTimeMs;

      float newTemp = sensors.getTempC(tempDeviceAddress);
      sensors.requestTemperatures(); // Trigger next conversion asynchronously

      if (newTemp == DEVICE_DISCONNECTED_C) {
        if (currentState != STATE_SAFETY_TRIP) {
          triggerSafetyShutdown("Sensor disconnected during loop.");
        }
      } else if (newTemp == DS18B20_POWERON_C) {
        // Reject the power-on artifact. If it persists the sensor is genuinely
        // faulty (e.g. brownout-resetting mid-session), so fail safe.
        suspectReadCount++;
        Serial.print(micros());
        Serial.print(F(",SENSOR_SUSPECT,"));
        Serial.println(suspectReadCount);
        if (suspectReadCount >= MAX_SUSPECT_READS && currentState != STATE_SAFETY_TRIP) {
          triggerSafetyShutdown("Sensor fault: persistent 85 C power-on value.");
        }
      } else {
        suspectReadCount = 0;
        currentTemp = newTemp;
        checkSafety();
      }
    }
  }

  // 2. State Machine logic
  switch (currentState) {
    case STATE_IDLE:
      // In IDLE, keep updating indicator LEDs
      updateStatusLEDs();
      break;

    case STATE_STIMULATING: {
      unsigned long elapsedMs = currentTimeMs - stateStartTimeMs;

      // Check if stimulation duration has completed
      if (elapsedMs >= STIMULATION_DURATION_MS) {
        Serial.print(micros());
        Serial.println(F(",STIM_END,DURATION_EXPIRED"));
        changeState(STATE_REST);
      } else {
        // Run active condition loop (heater thermostat; NIR pulses run on Timer1)
        updateActuators();
      }
      break;
    }

    case STATE_REST: {
      unsigned long elapsedMs = currentTimeMs - stateStartTimeMs;

      // Print periodic update of rest phase countdown (every 1s)
      if (currentTimeMs - lastLogTimeMs >= LOG_POLL_INTERVAL_MS) {
        lastLogTimeMs = currentTimeMs;
        unsigned long remainingSec = (REST_DURATION_MS - elapsedMs) / 1000;
        Serial.print(micros());
        Serial.print(F(",REST_COUNTDOWN,"));
        Serial.println(remainingSec);
      }

      if (elapsedMs >= REST_DURATION_MS) {
        Serial.print(micros());
        Serial.println(F(",REST_END,COOLDOWN_EXPIRED"));
        changeState(STATE_IDLE);
      }
      break;
    }

    case STATE_SAFETY_TRIP:
      // Flashes PIN_LED_ERROR at 10Hz
      flashErrorLED();
      break;
  }

  // 3. User interaction interface (USB serial only; no physical buttons)
  handleSerialCommands();
}

/**
 * @brief Timer1 compare-match ISR. Toggles the NIR pin at a fixed interval and
 *        records the edge (time + state) into the ring buffer for later logging.
 *        Does no Serial I/O so it stays short and deterministic.
 */
ISR(TIMER1_COMPA_vect) {
  nirPulseState = !nirPulseState;
  digitalWrite(PIN_NIR_LED, nirPulseState ? HIGH : LOW);

  uint8_t next = (pulseBufHead + 1) % PULSE_BUF_SIZE;
  if (next != pulseBufTail) {
    pulseEvtTimeUs[pulseBufHead] = micros();
    pulseEvtState[pulseBufHead] = nirPulseState ? 1 : 0;
    pulseBufHead = next;
  } else {
    pulseDropped++;
  }
}

/**
 * @brief Starts the Timer1-driven NIR pulse train with the given half-period compare value.
 */
void startNirPulse(unsigned int ocrValue) {
  noInterrupts();
  // Reset the ring buffer and record the initial rising edge.
  pulseBufTail = 0;
  pulseBufHead = 0;
  pulseDropped = 0;
  nirPulseState = true;
  digitalWrite(PIN_NIR_LED, HIGH);
  pulseEvtTimeUs[0] = micros();
  pulseEvtState[0] = 1;
  pulseBufHead = 1;

  // Configure Timer1: CTC mode (WGM12), prescaler 64 (CS11|CS10) -> 4 us/tick.
  TCCR1A = 0;
  TCCR1B = 0;
  TCNT1 = 0;
  OCR1A = ocrValue;
  TCCR1B |= (1 << WGM12);
  TCCR1B |= (1 << CS11) | (1 << CS10);
  TIMSK1 |= (1 << OCIE1A);
  interrupts();
}

/**
 * @brief Stops the Timer1 pulse train and forces the NIR line LOW.
 */
void stopNirPulse() {
  noInterrupts();
  TIMSK1 &= ~(1 << OCIE1A);
  TCCR1B = 0;
  interrupts();
  digitalWrite(PIN_NIR_LED, LOW);
  nirPulseState = false;
}

/**
 * @brief Drains queued pulse edges to Serial. Called from loop() so the ISR never blocks.
 */
void drainPulseLog() {
  while (pulseBufTail != pulseBufHead) {
    noInterrupts();
    unsigned long t = pulseEvtTimeUs[pulseBufTail];
    uint8_t s = pulseEvtState[pulseBufTail];
    interrupts();

    Serial.print(t);
    Serial.print(F(",PULSE,"));
    Serial.println(s);

    pulseBufTail = (pulseBufTail + 1) % PULSE_BUF_SIZE;
  }

  if (pulseDropped > 0) {
    noInterrupts();
    unsigned int d = pulseDropped;
    pulseDropped = 0;
    interrupts();
    Serial.print(micros());
    Serial.print(F(",PULSE_DROPPED,"));
    Serial.println(d);
  }
}

/**
 * @brief Safely transitions system between states, setting outputs appropriately.
 */
void changeState(SystemState newState) {
  unsigned long nowUs = micros();
  Serial.print(nowUs);
  Serial.print(F(",STATE_CHANGE,"));
  Serial.print(currentState);
  Serial.print(F(","));
  Serial.println(newState);

  currentState = newState;
  stateStartTimeMs = millis();
  lastLogTimeMs = stateStartTimeMs;

  if (currentState == STATE_STIMULATING) {
    // BLINDING CONSTRAINT: All indicators MUST be turned OFF before actuators run
    digitalWrite(PIN_LED_HEATING, LOW);
    digitalWrite(PIN_LED_10HZ, LOW);
    digitalWrite(PIN_LED_40HZ, LOW);
    digitalWrite(PIN_LED_ERROR, LOW);

    // Announce stimulation start (also drives the Web Serial dashboard indicator).
    Serial.print(micros());
    Serial.print(F(",STIM_START,"));
    Serial.println((int)selectedCondition);

    // Start the pulsed NIR conditions on the hardware timer.
    if (selectedCondition == COND_10HZ) {
      startNirPulse(TIMER1_OCR_10HZ);
    } else if (selectedCondition == COND_40HZ) {
      startNirPulse(TIMER1_OCR_40HZ);
    } else if (selectedCondition == COND_HEATING) {
      // No NIR pulse; the heater controller runs from loop().
#if HEATER_USE_PID
      // Reset the PID and announce the heater engaged (one HEATER,1 for the whole
      // run; the loop then modulates the pin via slow-PWM and streams HEATER_PID
      // diagnostics). In hysteresis mode runHeaterThermostat() emits HEATER edges.
      resetHeaterPID();
      Serial.print(micros());
      Serial.println(F(",HEATER,1"));
#endif
    }
  } else {
    // In REST, IDLE, or TRIP: stop the pulse train and turn off stimulation outputs.
    stopNirPulse();
    digitalWrite(PIN_HEATER, LOW);

    // Flush any pulse edges still queued by the ISR, then explicitly announce both
    // actuators OFF. Without these events the pins were driven LOW silently, so the
    // dashboard's NIR/heater indicators stayed latched ON after an abort (and a
    // buffered PULSE,1 edge could even arrive after the state change).
    drainPulseLog();
    unsigned long offUs = micros();
    Serial.print(offUs);
    Serial.println(F(",PULSE,0"));
    Serial.print(offUs);
    Serial.println(F(",HEATER,0"));
  }

  // Refresh physical LED indicators
  updateStatusLEDs();
}

/**
 * @brief Safety monitor checking skin temperature and taking corrective actions.
 */
void checkSafety() {
  // Trip once and stay latched: while already tripped, keep logging temperature
  // (so the operator can watch it cool down) without re-emitting SAFETY_TRIP.
  if (currentTemp >= MAX_SAFE_TEMP && currentState != STATE_SAFETY_TRIP) {
    char reasonBuf[64];
    snprintf(reasonBuf, sizeof(reasonBuf), "Over-temp detected: %s C", String(currentTemp, 2).c_str());
    triggerSafetyShutdown(reasonBuf);
    return;
  }

  // Rate-of-rise cutoff: trip if the temperature is climbing implausibly fast,
  // rather than waiting to hit 40 C (catches a runaway ~1 s sooner).
  static float prevRateTemp = -1000.0;
  static unsigned long prevRateMs = 0;
  unsigned long nowMs = millis();
  if (prevRateTemp > -100.0 && currentState != STATE_SAFETY_TRIP) {
    float dts = (nowMs - prevRateMs) / 1000.0;
    if (dts > 0.05 && (currentTemp - prevRateTemp) / dts > HEATER_MAX_RISE_C_PER_S) {
      triggerSafetyShutdown("Temperature rising too fast");
      prevRateTemp = currentTemp;
      prevRateMs = nowMs;
      return;
    }
  }
  prevRateTemp = currentTemp;
  prevRateMs = nowMs;

  // Periodic temperature logging (every 1 second)
  static unsigned long lastTempLogMs = 0;
  if (millis() - lastTempLogMs >= 1000) {
    lastTempLogMs = millis();
    Serial.print(micros());
    Serial.print(F(",TEMP_LOG,"));
    Serial.print(currentTemp, 2);
    Serial.print(F(","));
    Serial.println(currentState == STATE_STIMULATING ? (int)selectedCondition : -1);
  }
}

/**
 * @brief Executes stimulation commands in a non-blocking loop.
 *        NIR pulses are timer-driven; only the heater thermostat runs here.
 */
void updateActuators() {
  if (currentState != STATE_STIMULATING) return;

  if (selectedCondition == COND_HEATING) {
#if HEATER_USE_PID
    runHeaterPID();
#else
    runHeaterThermostat();
#endif
  }
  // COND_10HZ / COND_40HZ are handled entirely by the Timer1 ISR.
}

/**
 * @brief Resets the heater PID state. Called when the heating condition starts.
 */
void resetHeaterPID() {
  heaterIntegral = 0.0;
  heaterPrevError = 0.0;
  heaterDerivFiltered = 0.0;
  heaterDuty = 0.0;
  heaterLastPidMs = millis();
  heaterWindowStartMs = millis();
  heaterLastPidLogMs = millis();
}

/**
 * @brief Closed-loop PID temperature control for the heating condition.
 *        Recomputes the duty at a fixed interval from the latest temperature and
 *        applies it as a time-proportioned (slow-PWM) output on the heater pin.
 *        The 40 C latching cutoff (checkSafety) still overrides everything.
 */
void runHeaterPID() {
  unsigned long nowMs = millis();

  // 1. Recompute the control output at a fixed interval using the latest sample.
  if (nowMs - heaterLastPidMs >= HEATER_PID_INTERVAL_MS) {
    float dt = (nowMs - heaterLastPidMs) / 1000.0;
    heaterLastPidMs = nowMs;

    float error = heaterTargetTemp - currentTemp;

    // Integrate with anti-windup: clamp so the Ki term stays within +/-HEATER_INTEGRAL_MAX.
    heaterIntegral += error * dt;
    if (HEATER_KI > 0.0) {
      float integralMax = HEATER_INTEGRAL_MAX / HEATER_KI;
      if (heaterIntegral > integralMax) heaterIntegral = integralMax;
      if (heaterIntegral < -integralMax) heaterIntegral = -integralMax;
    }

    // Derivative on error, EMA-smoothed (the 10-bit sensor is quantised/noisy).
    float rawDeriv = (dt > 0.0) ? (error - heaterPrevError) / dt : 0.0;
    heaterDerivFiltered = HEATER_D_FILTER * heaterDerivFiltered + (1.0 - HEATER_D_FILTER) * rawDeriv;
    heaterPrevError = error;

    float output = HEATER_KP * error + HEATER_KI * heaterIntegral + HEATER_KD * heaterDerivFiltered;
    if (output < 0.0) output = 0.0;
    if (output > HEATER_MAX_DUTY) output = HEATER_MAX_DUTY; // hard safety cap on heater power
    heaterDuty = output;

    // Diagnostics at 1 Hz for logging / tuning (duty %, temp, target).
    if (nowMs - heaterLastPidLogMs >= 1000) {
      heaterLastPidLogMs = nowMs;
      Serial.print(micros());
      Serial.print(F(",HEATER_PID,"));
      Serial.print((int)(heaterDuty * 100.0 + 0.5));
      Serial.print(F(","));
      Serial.print(currentTemp, 2);
      Serial.print(F(","));
      Serial.println(heaterTargetTemp, 2);
    }
  }

  // 2. Apply the duty as a time-proportioned output over the PWM window.
  if (nowMs - heaterWindowStartMs >= HEATER_PWM_WINDOW_MS) {
    heaterWindowStartMs += HEATER_PWM_WINDOW_MS;
    // If the loop fell far behind, snap the window to now to avoid a burst.
    if (nowMs - heaterWindowStartMs >= HEATER_PWM_WINDOW_MS) heaterWindowStartMs = nowMs;
  }
  unsigned long onTimeMs = (unsigned long)(heaterDuty * HEATER_PWM_WINDOW_MS);
  bool pinOn = (nowMs - heaterWindowStartMs) < onTimeMs;
  digitalWrite(PIN_HEATER, pinOn ? HIGH : LOW);
}

/**
 * @brief Controls the heating ring using a standard On-Off hysteresis loop.
 */
void runHeaterThermostat() {
  if (currentTemp < (heaterTargetTemp - HEATER_HYSTERESIS)) {
    if (digitalRead(PIN_HEATER) == LOW) {
      digitalWrite(PIN_HEATER, HIGH);
      Serial.print(micros());
      Serial.println(F(",HEATER,1"));
    }
  } else if (currentTemp > heaterTargetTemp) {
    if (digitalRead(PIN_HEATER) == HIGH) {
      digitalWrite(PIN_HEATER, LOW);
      Serial.print(micros());
      Serial.println(F(",HEATER,0"));
    }
  }
}

/**
 * @brief Triggers immediate latching safety shutdown.
 */
void triggerSafetyShutdown(const char* reason) {
  currentState = STATE_SAFETY_TRIP;

  // Stop the pulse timer and power off every actuator instantly.
  stopNirPulse();
  digitalWrite(PIN_HEATER, LOW);
  digitalWrite(PIN_NIR_LED, LOW);
#if TB_STBY_CONTROL
  // Independent hardware kill: disable the TB6612 outputs entirely.
  digitalWrite(PIN_TB_STBY, LOW);
#endif
  digitalWrite(PIN_LED_HEATING, LOW);
  digitalWrite(PIN_LED_10HZ, LOW);
  digitalWrite(PIN_LED_40HZ, LOW);

  digitalWrite(PIN_LED_ERROR, HIGH);

  // Record the actuator-off transitions in the log before announcing the trip.
  drainPulseLog();
  unsigned long offUs = micros();
  Serial.print(offUs);
  Serial.println(F(",PULSE,0"));
  Serial.print(offUs);
  Serial.println(F(",HEATER,0"));

  Serial.print(micros());
  Serial.print(F(",SAFETY_TRIP,"));
  Serial.println(reason);
}

/**
 * @brief Cycles mode selection (Heating -> 10 Hz -> 40 Hz -> Heating).
 *        Allowed while IDLE, and also LIVE during stimulation: the running
 *        actuator is stopped and the new condition starts immediately, keeping
 *        the original stimulation countdown. Not allowed in REST or after a trip.
 */
void cycleMode() {
  if (currentState != STATE_IDLE && currentState != STATE_STIMULATING) return;

  selectedCondition = (StimCondition)((selectedCondition + 1) % COND_COUNT);
  Serial.print(micros());
  Serial.print(F(",MODE_SELECT,"));
  Serial.println(selectedCondition);

  if (currentState == STATE_STIMULATING) {
    // Live switch: kill the current actuator cleanly (with explicit OFF events,
    // same as an abort), then start the newly selected condition.
    stopNirPulse();
    digitalWrite(PIN_HEATER, LOW);
    drainPulseLog();
    unsigned long offUs = micros();
    Serial.print(offUs);
    Serial.println(F(",PULSE,0"));
    Serial.print(offUs);
    Serial.println(F(",HEATER,0"));

    if (selectedCondition == COND_10HZ) {
      startNirPulse(TIMER1_OCR_10HZ);
    } else if (selectedCondition == COND_40HZ) {
      startNirPulse(TIMER1_OCR_40HZ);
    }
    // COND_HEATING: runHeaterThermostat() takes over from loop().

    // Distinct event so the dashboard + LSL/EEG marker stream can timestamp
    // exactly when the active condition changed mid-run.
    Serial.print(micros());
    Serial.print(F(",COND_SWITCH,"));
    Serial.println((int)selectedCondition);
  }
  updateStatusLEDs();
}

/**
 * @brief Starts the selected stimulation condition.
 */
void startStimulation() {
  if (currentState != STATE_IDLE) return;
  changeState(STATE_STIMULATING);
}

/**
 * @brief Stops active stimulation immediately and returns to IDLE.
 */
void stopStimulation(const char* reason) {
  if (currentState != STATE_STIMULATING && currentState != STATE_REST) return;
  Serial.print(micros());
  Serial.print(F(",STIM_STOP,"));
  Serial.println(reason);
  changeState(STATE_IDLE);
}

/**
 * @brief Interface commands through Serial input (no physical buttons on this build).
 */
void handleSerialCommands() {
  if (Serial.available() > 0) {
    char cmd = Serial.read();

    // Skip line endings
    if (cmd == '\r' || cmd == '\n') return;

    switch (cmd) {
      case 'M':
      case 'm':
        cycleMode();
        break;

      case 'G':
      case 'g': // Go / Start
        startStimulation();
        break;

      case 'X':
      case 'x': // Stop
        stopStimulation("SERIAL_COMMAND_ABORT");
        break;

      case 'S':
      case 's': // Simulate over-temperature event
        if (currentState != STATE_SAFETY_TRIP) {
          Serial.println(F("# Simulating high temperature spike (41.5 C)..."));
          currentTemp = 41.5;
          checkSafety();
        }
        break;

      case 'H':
      case 'h': { // Set heating-control target temperature, e.g. "H38.25\n"
        // Read the numeric argument that follows the command letter. Clamp it
        // strictly below the 40 C safety cutoff so a bad value can never command
        // an unsafe target; the latching cutoff remains the ultimate guard.
        float requested = Serial.parseFloat();
        if (requested < HEATER_TARGET_MIN) requested = HEATER_TARGET_MIN;
        if (requested > HEATER_TARGET_MAX) requested = HEATER_TARGET_MAX;
        heaterTargetTemp = requested;
        Serial.print(micros());
        Serial.print(F(",HEATER_TARGET,"));
        Serial.println(heaterTargetTemp, 2);
        break;
      }

      case 'R':
      case 'r': // Reset safety trip
        if (currentState == STATE_SAFETY_TRIP) {
#if TB_STBY_CONTROL
          // Re-enable the driver before re-measuring.
          digitalWrite(PIN_TB_STBY, HIGH);
#endif
          sensors.requestTemperatures();
          delay(200); // Small blocking delay for manual override verification
          float checkTemp = sensors.getTempC(tempDeviceAddress);

          if (checkTemp != DEVICE_DISCONNECTED_C && checkTemp < MAX_SAFE_TEMP) {
            digitalWrite(PIN_LED_ERROR, LOW);
            currentTemp = checkTemp;
            suspectReadCount = 0;
            Serial.println(F("# Safety trip successfully reset. Re-entering IDLE state."));
            // Use changeState so a STATE_CHANGE event is emitted - without it the
            // dashboard stayed stuck on "SAFETY SHUTDOWN ACTIVE" after a reset.
            changeState(STATE_IDLE);
          } else {
#if TB_STBY_CONTROL
            // Stay tripped: put the driver back into standby.
            digitalWrite(PIN_TB_STBY, LOW);
#endif
            Serial.print(F("# Reset failed. Temp still too high: "));
            Serial.print(checkTemp);
            Serial.println(F(" C"));
          }
        }
        break;

      default:
        break;
    }
  }
}

/**
 * @brief Controls physical mode indicator LEDs during IDLE state.
 */
void updateStatusLEDs() {
  // If safety is tripped, let flashErrorLED() handle PIN_LED_ERROR
  if (currentState == STATE_SAFETY_TRIP) return;

  if (currentState == STATE_IDLE) {
    digitalWrite(PIN_LED_HEATING, selectedCondition == COND_HEATING ? HIGH : LOW);
    digitalWrite(PIN_LED_10HZ, selectedCondition == COND_10HZ ? HIGH : LOW);
    digitalWrite(PIN_LED_40HZ, selectedCondition == COND_40HZ ? HIGH : LOW);
    digitalWrite(PIN_LED_ERROR, LOW);
  } else if (currentState == STATE_REST) {
    // In rest phase, keep all condition indicators OFF to preserve blinding.
    digitalWrite(PIN_LED_HEATING, LOW);
    digitalWrite(PIN_LED_10HZ, LOW);
    digitalWrite(PIN_LED_40HZ, LOW);
    digitalWrite(PIN_LED_ERROR, LOW);
  }
}

/**
 * @brief Rapidly flashes the error LED to provide warning.
 */
void flashErrorLED() {
  static unsigned long lastFlashTime = 0;
  static bool flashState = false;
  unsigned long now = millis();

  if (now - lastFlashTime >= 100) { // 10Hz flash
    lastFlashTime = now;
    flashState = !flashState;
    digitalWrite(PIN_LED_ERROR, flashState ? HIGH : LOW);
  }
}
